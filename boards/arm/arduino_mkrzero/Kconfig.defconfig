## boards/arm/arduino_mkrzero/Kconfig.defconfig
```kconfig
# Kconfig - Arduino MKRZero board configuration
#
# Copyright (c) 2018 Madani Lainani.
# SPDX-License-Identifier: Apache-2.0

if BOARD_ARDUINO_MKRZERO

config BOARD
	default "arduino_mkrzero"

# if I2C

# config I2C_SAM_TWIHS
# 	default y

# config I2C_0
# 	default y

# endif # I2C

endif # BOARD_ARDUINO_MKRZERO
```
